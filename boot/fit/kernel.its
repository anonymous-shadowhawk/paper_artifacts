## boot/fit/kernel.its
```
/dts-v1/;
/ {
 description = "PAC Tier-1 FIT";
 #address-cells = <1>;
 images {
  kernel@1 {
    description = "Linux kernel";
    data = /incbin/("Image");
    type = "kernel";
    arch = "arm64";
    os = "linux";
    compression = "none";
    load = <0x80000>;
    entry = <0x80000>;
    hash@1 { algo = "sha256"; };
  };
  ramdisk@1 {
    description = "Tier-1 initramfs";
    data = /incbin/("initramfs.cpio.gz");
    type = "ramdisk";
    arch = "arm64";
    os = "linux";
    compression = "none";
    hash@1 { algo = "sha256"; };
  };
  fdt@1 {
    description = "virt DTB";
    data = /incbin/("virt.dtb");
    type = "flat_dt";
    arch = "arm64";
    compression = "none";
    hash@1 { algo = "sha256"; };
  };
 };
 configurations {
  default = "conf@1";
  conf@1 {
    kernel = "kernel@1";
    ramdisk = "ramdisk@1";
    fdt = "fdt@1";
    signature@1 {
      algo = "sha256,rsa2048";
      key-name-hint = "pac_signing";
      sign-images = "kernel", "ramdisk", "fdt";
    };
  };
 };
};
```
